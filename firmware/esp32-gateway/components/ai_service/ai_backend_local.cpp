/**
 * @file ai_backend_local.cpp
 * @author EnterWorldDoor
 * @brief Local TFLite Micro inference backend for ESP32-S3
 *
 * Dependencies: esp-tflite-micro (via ESP-IDF component manager)
 *   Install: idf.py add-dependency "esp-tflite-micro"
 *
 * Model: model_data.h (generated by edge-ai/prepare_and_train.py)
 *   Input:  [32, 24] float32 feature tensor (TIME_STEPS, AI_NUM_FEATURES)
 *   Output: [4] float32 softmax [normal, imbalance, misalignment, bearing_fault]
 *   Architecture: 1D-CNN (Conv1D + MaxPool1D + GlobalAvgPool1D + Dense) — no LSTM
 */

#include "ai_backend.h"
#include "global_error.h"
#include "esp_log.h"
#include <string.h>
#include <math.h>

static const char *TAG = "AI-BACKEND";

/* TFLite Micro C++ headers */
#if __has_include("tensorflow/lite/micro/micro_interpreter.h")
#define TFLITE_AVAILABLE 1

#include "tensorflow/lite/micro/micro_interpreter.h"
#include "tensorflow/lite/micro/micro_mutable_op_resolver.h"
#include "tensorflow/lite/micro/micro_log.h"
#include "tensorflow/lite/micro/system_setup.h"
#include "tensorflow/lite/schema/schema_generated.h"

#include "model_data.h"

#else
#define TFLITE_AVAILABLE 0
#endif

/* ==================== TFLite state ==================== */

/* Move arena to PSRAM to avoid DRAM overflow (8MB PSRAM available) */
#if CONFIG_SPIRAM
#include "esp_heap_caps.h"
#define AI_ARENA_SIZE  (150 * 1024)
static uint8_t *g_arena_ptr = NULL;  /* Allocated in PSRAM at init */
#define GET_ARENA() g_arena_ptr
#else
#define AI_ARENA_SIZE  (24 * 1024)  /* 24KB — actual usage ~12KB, 2x safety margin */
static uint8_t g_arena[AI_ARENA_SIZE] __attribute__((aligned(16)));
#define GET_ARENA() g_arena
#endif

static bool g_tflite_ready = false;

#if TFLITE_AVAILABLE

static tflite::MicroInterpreter *g_interpreter = nullptr;
static TfLiteTensor *g_input_tensor  = nullptr;
static TfLiteTensor *g_output_tensor = nullptr;

/* Op resolver — ops for 1D-CNN: Conv2D, MaxPool2D, Mean, FullyConnected, Softmax, Relu */
static tflite::MicroMutableOpResolver<12> *g_resolver = nullptr;

static void tflite_error_reporter(const char *format, va_list args)
{
    char buf[128];
    vsnprintf(buf, sizeof(buf), format, args);
    ESP_LOGE(TAG, "TFLite: %s", buf);
}

/* ==================== Backend implementation ==================== */

static int local_init(void)
{
    if (g_tflite_ready) return APP_ERR_OK;

    if (model_data_len == 0) {
        ESP_LOGE(TAG, "Model data is empty or missing");
        return APP_ERR_AI_MODEL_INVALID;
    }

    ESP_LOGI(TAG, "Loading model: %u bytes", (unsigned)model_data_len);

    const tflite::Model *model = tflite::GetModel(model_data);
    if (model->version() != TFLITE_SCHEMA_VERSION) {
        ESP_LOGE(TAG, "Model schema version mismatch: got %u, expected %u",
                 model->version(), TFLITE_SCHEMA_VERSION);
        return APP_ERR_AI_MODEL_INVALID;
    }

    /* Build op resolver — ops used by our 1D-CNN model */
    g_resolver = new tflite::MicroMutableOpResolver<12>();
    if (!g_resolver) return APP_ERR_NO_MEM;

    g_resolver->AddConv2D();          /* Conv1D lowered to Conv2D */
    g_resolver->AddMaxPool2D();       /* MaxPool1D lowered to MaxPool2D */
    g_resolver->AddFullyConnected();  /* Dense layers */
    g_resolver->AddSoftmax();         /* Output */
    g_resolver->AddRelu();            /* Activations */
    g_resolver->AddReshape();         /* Shape handling */
    g_resolver->AddMean();            /* GlobalAveragePooling1D */
    g_resolver->AddExpandDims();      /* tf.expand_dims */
    g_resolver->AddMul();             /* Optional: for batchnorm folding */
    g_resolver->AddAdd();             /* Optional: for residual connections */
    g_resolver->AddPad();             /* Padding */

    /* Allocate arena (PSRAM if available, otherwise internal DRAM) */
#if CONFIG_SPIRAM
    g_arena_ptr = (uint8_t *)heap_caps_malloc(AI_ARENA_SIZE, MALLOC_CAP_SPIRAM | MALLOC_CAP_8BIT);
    if (!g_arena_ptr) {
        ESP_LOGE(TAG, "Failed to allocate %u bytes in PSRAM", (unsigned)AI_ARENA_SIZE);
        return APP_ERR_NO_MEM;
    }
    ESP_LOGI(TAG, "TFLite arena: %u bytes in PSRAM", (unsigned)AI_ARENA_SIZE);
#else
    ESP_LOGI(TAG, "TFLite arena: %u bytes in internal DRAM", (unsigned)AI_ARENA_SIZE);
#endif

    /* Create interpreter */
    g_interpreter = new tflite::MicroInterpreter(
        model, *g_resolver, GET_ARENA(), AI_ARENA_SIZE);
    if (!g_interpreter) {
        ESP_LOGE(TAG, "Failed to create TFLite interpreter");
        return APP_ERR_NO_MEM;
    }

    /* Allocate tensors */
    TfLiteStatus alloc_status = g_interpreter->AllocateTensors();
    if (alloc_status != kTfLiteOk) {
        ESP_LOGE(TAG, "Tensor allocation failed (arena=%u bytes)", (unsigned)AI_ARENA_SIZE);
        return APP_ERR_NO_MEM;
    }

    ESP_LOGI(TAG, "Arena used: %u / %u bytes",
             (unsigned)g_interpreter->arena_used_bytes(), (unsigned)AI_ARENA_SIZE);

    /* Get input/output tensor pointers */
    g_input_tensor  = g_interpreter->input(0);
    g_output_tensor = g_interpreter->output(0);

    if (!g_input_tensor || !g_output_tensor) {
        ESP_LOGE(TAG, "Failed to get input/output tensors");
        return APP_ERR_AI_MODEL_INVALID;
    }

    /* Log model info */
    int input_size = 1;
    for (int i = 0; i < g_input_tensor->dims->size; i++) {
        input_size *= g_input_tensor->dims->data[i];
    }
    int output_classes = 1;
    for (int i = 0; i < g_output_tensor->dims->size; i++) {
        output_classes *= g_output_tensor->dims->data[i];
    }
    ESP_LOGI(TAG, "Input:  type=%d shape=[%d,%d,%d] size=%d",
             g_input_tensor->type,
             g_input_tensor->dims->data[0],
             g_input_tensor->dims->data[1],
             g_input_tensor->dims->size > 2 ? g_input_tensor->dims->data[2] : 0,
             input_size);
    ESP_LOGI(TAG, "Output: type=%d classes=%d",
             g_output_tensor->type, output_classes);

    g_tflite_ready = true;
    return APP_ERR_OK;
}

static int local_infer(const float *features, ai_classification_t *out)
{
    if (!g_tflite_ready || !g_interpreter || !g_input_tensor || !g_output_tensor) {
        return APP_ERR_AI_INFERENCE_FAIL;
    }
    if (!features || !out) {
        return APP_ERR_INVALID_PARAM;
    }

    /* Compute input size from tensor shape */
    int input_size = 1;
    for (int i = 0; i < g_input_tensor->dims->size; i++) {
        input_size *= g_input_tensor->dims->data[i];
    }

    /* Copy features to input tensor (FP32) */
    if (g_input_tensor->type == kTfLiteFloat32) {
        memcpy(g_input_tensor->data.f, features, input_size * sizeof(float));
    } else if (g_input_tensor->type == kTfLiteInt8) {
        float scale  = g_input_tensor->params.scale;
        int   zero_point = g_input_tensor->params.zero_point;
        for (int i = 0; i < input_size; i++) {
            int32_t q = (int32_t)roundf(features[i] / scale) + zero_point;
            if (q < -128) q = -128;
            if (q > 127)  q = 127;
            g_input_tensor->data.int8[i] = (int8_t)q;
        }
    } else {
        ESP_LOGE(TAG, "Unsupported input type: %d", g_input_tensor->type);
        return APP_ERR_AI_INFERENCE_FAIL;
    }

    /* Run inference */
    TfLiteStatus status = g_interpreter->Invoke();
    if (status != kTfLiteOk) {
        ESP_LOGE(TAG, "Inference invoke failed: %d", status);
        return APP_ERR_AI_INFERENCE_FAIL;
    }

    /* Read output — determine number of classes from tensor shape */
    int output_size = 1;
    for (int i = 0; i < g_output_tensor->dims->size; i++) {
        output_size *= g_output_tensor->dims->data[i];
    }

    float *probs = (float *)malloc(output_size * sizeof(float));
    if (!probs) {
        ESP_LOGE(TAG, "Failed to allocate %d floats for output", output_size);
        return APP_ERR_NO_MEM;
    }

    if (g_output_tensor->type == kTfLiteFloat32) {
        for (int i = 0; i < output_size; i++) {
            probs[i] = g_output_tensor->data.f[i];
        }
    } else if (g_output_tensor->type == kTfLiteInt8) {
        float scale  = g_output_tensor->params.scale;
        int   zero_point = g_output_tensor->params.zero_point;
        for (int i = 0; i < output_size; i++) {
            probs[i] = (float)(g_output_tensor->data.int8[i] - zero_point) * scale;
        }
    }

    /* Find argmax */
    int   best_class = 0;
    float best_prob  = probs[0];
    for (int i = 1; i < output_size; i++) {
        if (probs[i] > best_prob) {
            best_prob  = probs[i];
            best_class = i;
        }
    }

    if (best_prob > 1.0f) best_prob = 1.0f;
    if (best_prob < 0.0f) best_prob = 0.0f;

    static const char *class_names[] = {
        "normal", "imbalance", "misalignment", "bearing_fault"
    };

    out->class_id   = (ai_class_id_t)best_class;
    out->confidence = best_prob;
    if (best_class < (int)(sizeof(class_names) / sizeof(class_names[0]))) {
        strncpy(out->class_name, class_names[best_class], sizeof(out->class_name) - 1);
    } else {
        snprintf(out->class_name, sizeof(out->class_name), "class_%d", best_class);
    }

    free(probs);
    return APP_ERR_OK;
}

static bool local_is_ready(void)
{
    return g_tflite_ready;
}

static void local_deinit(void)
{
    delete g_interpreter;  g_interpreter = nullptr;
    delete g_resolver;     g_resolver = nullptr;
    g_tflite_ready = false;
    g_input_tensor  = nullptr;
    g_output_tensor = nullptr;
#if CONFIG_SPIRAM
    if (g_arena_ptr) {
        free(g_arena_ptr);
        g_arena_ptr = NULL;
    }
#endif
}

#else  /* !TFLITE_AVAILABLE */

static int local_init(void)
{
    ESP_LOGW(TAG, "TFLite Micro component not installed — local backend disabled");
    ESP_LOGW(TAG, "Install with: idf.py add-dependency esp-tflite-micro");
    return APP_ERR_AI_MODEL_INVALID;
}

static int local_infer(const float *features, ai_classification_t *out)
{
    (void)features;
    (void)out;
    return APP_ERR_AI_INFERENCE_FAIL;
}

static bool local_is_ready(void) { return false; }
static void local_deinit(void) {}

#endif /* TFLITE_AVAILABLE */

/* ==================== Backend vtable ==================== */

extern "C" {

const ai_backend_t ai_backend_local = {
    .init     = local_init,
    .infer    = local_infer,
    .is_ready = local_is_ready,
    .deinit   = local_deinit,
};

} /* extern "C" */
