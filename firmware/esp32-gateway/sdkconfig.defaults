## firmware/esp32-gateway/sdkconfig.defaults
```kconfig
# ESP32-Gateway 关键配置 - 解决栈溢出问题合集
# 文件: sdkconfig.defaults
# ESP-IDF v5.5.3 兼容版本

# ============================================================
# 1. 系统事件任务栈大小 (修复 stack overflow in task sys_evt)
# ============================================================
#
# 默认值: 4096 bytes
# 问题: WiFi初始化时产生大量事件,导致栈溢出
# 解决: 增大到 8192 bytes (8KB)
CONFIG_SYSTEM_EVENT_TASK_STACK_SIZE=8192

# ============================================================
# 2. 定时器/时间任务栈大小 (修复 stack overflow in task time_auto)
# ============================================================
#
# 默认值: 2048-4096 bytes (取决于ESP-IDF版本)
# 问题: SNTP/时间同步任务需要较大栈空间处理网络回调
# 解决: 增大到 6144 bytes (6KB)
CONFIG_ESP_TIMER_TASK_STACK_SIZE=6144
CONFIG_ESP_SYSTEM_MEMPROT_FEATURE=1

# ============================================================
# 3. TCP/IP 协议栈优化
# ============================================================
#
# 增大TCP接收缓冲区,防止WiFi连接不稳定时数据丢失
CONFIG_LWIP_TCP_RECVMBOX_SIZE=32
CONFIG_LWIP_TCP_SND_BUF_SIZE=8192
CONFIG_LWIP_TCP_RECVMBUF_SIZE=8192

# ============================================================
# 3.5 分区表配置 (使用自定义 partitions.csv, 16MB Flash)
# ============================================================
CONFIG_PARTITION_TABLE_CUSTOM=y
# CONFIG_PARTITION_TABLE_SINGLE_APP is not set

# ============================================================
# 4. PSRAM 启用 (ESP32-S3 DevKitC-1: 8MB Octal PSRAM)
# ============================================================
CONFIG_ESP32S3_SPIRAM_SUPPORT=y
CONFIG_SPIRAM_MODE_OCT=y
CONFIG_SPIRAM_SPEED_80M=y
CONFIG_SPIRAM_BOOT_INIT=y
CONFIG_SPIRAM_USE_CAPS_ALLOC=y

# ============================================================
# 5. 编译优化 (减小固件体积)
# ============================================================
CONFIG_COMPILER_OPTIMIZATION_SIZE=y

# ============================================================
# 6. OTA 固件升级
# ============================================================
CONFIG_OTA_ALLOW_HTTP=y

# ============================================================
# 已移除的无效配置项 (ESP-IDF v5.5.3中不存在)
# ============================================================
# CONFIG_FREERTOS_IDLE_TASK_STACK_SIZE=2048      ← 不存在!
# CONFIG_MAIN_TASK_STACK_SIZE=8192                ← 不存在!
```

## firmware/esp32-gateway/sdkconfig.defaults.models
```kconfig
# P1 Training Data Sync - SPIFFS model partition support
# Merge with existing sdkconfig.defaults
CONFIG_SPIFFS_MAX_PARTITIONS=3
CONFIG_SPIFFS_USE_MTIME=y
```
